/**
 * @file    font_embedded.c
 * @brief   8x8 pixel bitmap font stored in MCU flash — no external flash dependency
 * @version 1.0
 * @date    Created:       2026-05-30
 *          Last modified: 2026-05-30
 * @note    Developed with Claude Sonnet 4.6 (Anthropic)
 *
 *  Font format: row-major, MSB = leftmost pixel (bit 7 = column 0).
 *  Printable ASCII 0x20–0x7E, indexed as font8x8[c - 0x20].
 */

#include "font_embedded.h"
#include "GUI.h"
#include <string.h>

// ---------------------------------------------------------------------------
// 8x8 bitmap font data (public domain — classic monospaced PC/embedded font)
// Each entry: 8 bytes, one per row, MSB = leftmost pixel.
// ---------------------------------------------------------------------------
static const uint8_t font8x8[95][8] = {
    {0x00,0x00,0x00,0x00,0x00,0x00,0x00,0x00}, // 0x20 ' '
    {0x18,0x3C,0x3C,0x18,0x18,0x00,0x18,0x00}, // 0x21 '!'
    {0x36,0x36,0x12,0x00,0x00,0x00,0x00,0x00}, // 0x22 '"'
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    {0x6E,0x3B,0x00,0x00,0x00,0x00,0x00,0x00}, // 0x7E '~'
};

// ---------------------------------------------------------------------------
// Internal helpers
// ---------------------------------------------------------------------------

static void draw_glyph(int16_t x, int16_t y, const uint8_t glyph[8],
                       uint8_t scale, uint16_t color)
{
    for (uint8_t row = 0; row < FONT_EMBEDDED_H; row++) {
        uint8_t bits = glyph[row];
        for (uint8_t col = 0; col < FONT_EMBEDDED_W; col++) {
            if (bits & (0x01u << col)) {
                if (scale == 1) {
                    GUI_DrawPixel(x + col, y + row, color);
                } else {
                    for (uint8_t sr = 0; sr < scale; sr++)
                        for (uint8_t sc = 0; sc < scale; sc++)
                            GUI_DrawPixel(x + col*scale + sc,
                                          y + row*scale + sr, color);
                }
            }
        }
    }
}

// ---------------------------------------------------------------------------
// Public API
// ---------------------------------------------------------------------------

void Font_DrawChar(int16_t x, int16_t y, char c, uint8_t scale, uint16_t color)
{
    uint8_t idx = (uint8_t)c;
    if (idx < 0x20u || idx > 0x7Eu) return;
    draw_glyph(x, y, font8x8[idx - 0x20u], scale, color);
}

void Font_DrawString(int16_t x, int16_t y, const char *str,
                     uint8_t scale, uint16_t color)
{
    if (!str) return;
    while (*str) {
        Font_DrawChar(x, y, *str++, scale, color);
        x += (int16_t)(FONT_EMBEDDED_W * scale);
    }
}

void Font_DrawStringCentered(int16_t x0, int16_t y0, int16_t x1, int16_t y1,
                              const char *str, uint8_t scale, uint16_t color)
{
    if (!str) return;

    int16_t text_w = (int16_t)(strlen(str) * FONT_EMBEDDED_W * scale);
    int16_t text_h = (int16_t)(FONT_EMBEDDED_H * scale);
    int16_t rect_w = x1 - x0;
    int16_t rect_h = y1 - y0;

    int16_t draw_x = x0 + (rect_w > text_w ? (rect_w - text_w) / 2 : 0);
    int16_t draw_y = y0 + (rect_h > text_h ? (rect_h - text_h) / 2 : 0);

    Font_DrawString(draw_x, draw_y, str, scale, color);
}
